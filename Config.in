## Config.in
```kconfig
menu "Custom packages"
source "$BR2_EXTERNAL_STT_ENV_PATH/package/stt_ihm/Config.in"
endmenu
```

## package/influxdb_golang_test/Config.in
```kconfig
config BR2_PACKAGE_INFLUXDB_GOLANG_TEST
	bool "go test"
	help
		Package pour l'application influxDB_test
```

## package/stt_ihm/Config.in
```kconfig
config BR2_PACKAGE_STT_IHM
	bool "stt ihm"
	depends on BR2_PACKAGE_SQLITE
	depends on BR2_PACKAGE_JANSSON
	help
		Package pour l'application STT
```
